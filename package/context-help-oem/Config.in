## package/context-help-oem/Config.in
```kconfig
config BR2_PACKAGE_CONTEXT_HELP_OEM
	prompt "Context help OEM ......... HTML ang image files for help sysytem"
	tristate
	default n if CONFIG_DEVEL
	help
		Package contains user manual, integrated into the web interface, OEM edition
```

## package/context-help/Config.in
```kconfig
config BR2_PACKAGE_CONTEXT_HELP
	prompt "Context help.............. HTML ang image files for help sysytem"
	tristate
	default n if CONFIG_DEVEL
	help
		Package contains user manual, integrated into the web interface
```

## package/eocd/Config.in
```kconfig
config BR2_PACKAGE_SIGRAND_EOCD
	prompt "eocd ................. Sigrand EOC channel daemon"
	tristate
	default y if CONFIG_DEVEL
	depends on BR2_LINUX_2_6_SIGRAND5120
```

## package/fcgi/Config.in
```kconfig
config BR2_PACKAGE_FCGI
	prompt "libfcgi............................ FastCGI library"
	tristate
	default n
	help
	  FastCGI application library
	  
	  http://www.fastcgi.com/
```

## package/kepler/Config.in
```kconfig
config BR2_PACKAGE_KEPLER
	prompt "kepler............................ Kepler is a Web development platform."
	tristate
	default n
	help
	  Kepler is a Web development platform.
	  
	  http://keplerproject.org/
```

## package/libsigc++/Config.in
```kconfig
config BR2_PACKAGE_LIBSIGCXX
	prompt "libsigcxx......................... libsigc++ implements a typesafe callback system for standard C++."
	tristate
	default n
	select BR2_PACKAGE_UCLIBCXX
	help
	    It allows you to define signals and to connect those signals to any 
	    callback function, either global or a member function, regardless of 
	    whether it is static or virtual.

	    http://ftp.gnome.org/
```

## package/ndyndns/Config.in
```kconfig
config BR2_PACKAGE_NDYNDNS
	prompt "ndyndns........................... DynDNS.com update daemon"
	tristate
	default N
	select BR2_COMPILE_CURL
	help
	    The ndyndns daemon is an update client for DynDNS.com. It
	    checks for an IP address change every two minutes, avoids
	    unnecessary updates, reports errors, logs to syslog, and
	    generally complies with everything required of a proper dyndns
	    client.

	    http://ndyndns.googlecode.com/
```

## package/oem-dslam/Config.in
```kconfig
config BR2_PACKAGE_SIGRAND_DSLAM
	prompt "DSLAM ................. Sigrand DSLAM control software"
	tristate
	default y if CONFIG_DEVEL
	depends on BR2_LINUX_2_6_SIGRAND5120

config BR2_PACKAGE_SIGRAND_DSLAM_DEBUG
	prompt "dslam_dbg ........... Sigrand DSLAM Debug"
	bool
	default n
	depends on BR2_LINUX_2_6_SIGRAND5120
	depends on BR2_PACKAGE_SIGRAND_MR17H
```

## package/oem-e1.g1/Config.in
```kconfig
config BR2_PACKAGE_SIGRAND_MR16G
	prompt "mr16g ................. Sigrand MR16G E1 adapter driver"
	tristate
	default y if CONFIG_DEVEL
	depends on BR2_LINUX_2_6_SIGRAND5120

config BR2_PACKAGE_SIGRAND_MR16G_DEBUG
	prompt "mr16g_debug ......... Sigrand MR17H SHDSL module Debug"
	bool
	default n
	depends on BR2_LINUX_2_6_SIGRAND5120
	depends on BR2_PACKAGE_SIGRAND_MR16G
```

## package/oem-e1.g2/Config.in
```kconfig
config BR2_PACKAGE_SIGRAND_MR17G
	prompt "mr17g ................. Sigrand MR17G E1 adapter driver"
	tristate
	default y if CONFIG_DEVEL
	depends on BR2_LINUX_2_6_SIGRAND5120

config BR2_PACKAGE_SIGRAND_MR17G_DEBUG
	prompt "mr17g_debug ......... Sigrand MR17G E1 module Debug"
	bool
	default n
	depends on BR2_LINUX_2_6_SIGRAND5120
	depends on BR2_PACKAGE_SIGRAND_MR17G
```

## package/oem-linkdeps/Config.in
```kconfig
config BR2_PACKAGE_SIGRAND_LINKDEPS
	prompt "LinkDeps ................. Inter-port link dependency tracking"
	bool
	default n
	depends on BR2_LINUX_2_6_SIGRAND5120
```

## package/oem-mux/Config.in
```kconfig
config BR2_PACKAGE_SIGRAND_MUX
	prompt "multiplexing .......... Sigrand Multiplexing control tool"
	tristate
	default y if CONFIG_DEVEL
	depends on BR2_LINUX_2_6_SIGRAND5120
```

## package/oem-pppft-mp/Config.in
```kconfig
config BR2_PACKAGE_SIGRAND_PPPFT_MP
	prompt "pppft-mp ................. Sigrand fault tolerant PPP multilink"
	bool
	default y if CONFIG_DEVEL
	depends on BR2_PACKAGE_PPP
	depends on BR2_LINUX_2_6_SIGRAND5120
```

## package/oem-rs232.g1/Config.in
```kconfig
config BR2_PACKAGE_SIGRAND_MR17S
	prompt "mr17s ................. Sigrand MR17S RS232 adapter driver"
	tristate
	default y if CONFIG_DEVEL
	depends on BR2_LINUX_2_6_SIGRAND5120

config BR2_PACKAGE_SIGRAND_MR17S_DEBUG
	prompt "mr17s_debug ......... Sigrand MR17S RS232 module Debug"
	bool
	default n
	depends on BR2_LINUX_2_6_SIGRAND5120
	depends on BR2_PACKAGE_SIGRAND_MR17S
```

## package/oem-shdsl.g1/Config.in
```kconfig
config BR2_PACKAGE_SIGRAND_MR16H
	prompt "mr16h ................. Sigrand MR16H SHDSL module driver"
	tristate
	default y if CONFIG_DEVEL
	depends on BR2_LINUX_2_6_SIGRAND5120

config BR2_PACKAGE_SIGRAND_MR16H_UEVENTS
	prompt "mr16h_linkevt ....... Sigrand MR16H link change events"
	bool
	default n
	depends on BR2_PACKAGE_SIGRAND_MR16H
	depends on BR2_PACKAGE_SIGRAND_LINKDEPS
```

## package/oem-shdsl.g2/Config.in
```kconfig
config BR2_PACKAGE_SIGRAND_MR17H
	prompt "mr17h ................. Sigrand MR17H SHDSL module driver"
	tristate
	default y if CONFIG_DEVEL
	depends on BR2_LINUX_2_6_SIGRAND5120

config BR2_PACKAGE_SIGRAND_MR17H_UEVENTS
	prompt "mr17h_linkevt ....... Sigrand MR17H link change events"
	bool
	default n
	depends on BR2_PACKAGE_SIGRAND_MR17H
	depends on BR2_PACKAGE_SIGRAND_LINKDEPS

config BR2_PACKAGE_SIGRAND_MR17H_DEBUG
	prompt "mr17h_dbg ........... Sigrand MR17H SHDSL module Debug"
	bool
	default n
	depends on BR2_LINUX_2_6_SIGRAND5120
	depends on BR2_PACKAGE_SIGRAND_MR17H
```

## package/oem-vendor/Config.in
```kconfig
#-------------- General OEM information ------------------------#
comment "General OEM information"
config BR2_SIGRAND_OEM_MANUFACTURER
prompt "Manufacturer"
string
default "Sigrand"

config BR2_SIGRAND_OEM_URL
prompt "Manufacturer URL"
string
default "http://www.sigrand.ru"

config BR2_SIGRAND_OEM_HOSTNAME
prompt "Default Hostname"
string
default "sigrand"

config BR2_SIGRAND_OEM_SYSNAME
prompt "Default system name"
string
default "Sigrand"

config BR2_SIGRAND_OEM_IFPFX
prompt "OEM interface prefix in module names."
string
default ""

#-------------- OEM Logos ------------------------#
comment "Logotypes"

config BR2_SIGRAND_OEM_LOGO
prompt "Left up corner logo"
string
default "default"

config BR2_SIGRAND_OEM_HEADERBG
prompt "Header background"
string
default "default"

config BR2_SIGRAND_OEM_BGROUND
prompt "Default system name"
string
default "default"

config BR2_SIGRAND_OEM_WF2_HEADER_LOGO
prompt "WF2: header logo"
string
default "default"

config BR2_SIGRAND_OEM_WF2_BOTTOM_LOGO
prompt "WF2: bottom logo"
string
default "default"

#-------------- OEM SHDSL modules ------------------------#

comment "MR17H SHDSL module"
config BR2_SIGRAND_OEM_MR17H
prompt "MR17H SHDSL module name"
string
default "MR17H"

config BR2_SIGRAND_OEM_MR17H_V1SFX
prompt "MR17H SHDSL module version 1 suffix"
string
default ""

config BR2_SIGRAND_OEM_MR17H_V2SFX
prompt "MR17H SHDSL module version 2 suffix"
string
default "+"

config BR2_SIGRAND_OEM_MR17H_PWRSFX
prompt "MR17H SHDSL module power source suffix"
string
default "P2"

config BR2_SIGRAND_OEM_MR17H_DRV
prompt "MR17H SHDSL module driver name"
string
default "mr17h"

config BR2_SIGRAND_OEM_MR17H_TOOL
prompt "MR17H SHDSL configuration tool name"
string
default "mr17h_cfg"

config BR2_SIGRAND_OEM_MR17H_DBGTOOL
prompt "MR17H SHDSL debugging tool name"
string
default "mr17h_debug"

#-------------

comment "MR16H SHDSL module"
config BR2_SIGRAND_OEM_MR16H
prompt "MR16H SHDSL module name"
string
default "MR16H"

config BR2_SIGRAND_OEM_MR16H_DRV
prompt "MR16H SHDSL module driver name"
string
default "mr16h"

config BR2_SIGRAND_OEM_MR16H_TOOL
prompt "MR16H SHDSL configuration tool name"
string
default "mr16h_cfg"

config BR2_SIGRAND_OEM_MR16H_DBGTOOL
prompt "MR16H SHDSL debugging tool name"
string
default "mr16h_debug"

#-------------- OEM E1 modules ------------------------#

comment "MR16G E1 module"
config BR2_SIGRAND_OEM_MR16G
prompt "MR16G E1 module name"
string
default "MR16G"

config BR2_SIGRAND_OEM_MR16G_DRV
prompt "MR16G E1 module driver name"
string
default "mr16g"

config BR2_SIGRAND_OEM_MR16G_TOOL
prompt "MR16G E1 configuration tool name"
string
default "mr16g_cfg"

config BR2_SIGRAND_OEM_MR16G_DBGTOOL
prompt "MR16G E1 debugging tool name"
string
default "mr16g_debug"

#-------------

comment "MR17G E1 module"
config BR2_SIGRAND_OEM_MR17G
prompt "MR17G E1 module name"
string
default "MR17G"

config BR2_SIGRAND_OEM_MR17G_DRV
prompt "MR17G E1 module driver name"
string
default "mr17g"

config BR2_SIGRAND_OEM_MR17G_TOOL
prompt "MR17G E1 configuration tool name"
string
default "mr17g_cfg"

config BR2_SIGRAND_OEM_MR17G_DBGTOOL
prompt "MR17G E1 debugging tool name"
string
default "mr17g_debug"


#-------------- OEM RS232 modules ------------------------#

comment "MR17S RS232 module"
config BR2_SIGRAND_OEM_MR17S
prompt "MR17S RS232 module name"
string
default "MR17S"

config BR2_SIGRAND_OEM_MR17S_DRV
prompt "MR17S RS232 module driver name"
string
default "mr17s"

config BR2_SIGRAND_OEM_MR17S_DBGTOOL
prompt "MR17S RS232 debugging tool name"
string
default "mr17s_debug"

config BR2_SIGRAND_OEM_MR17S_TOOL
prompt "MR17S RS232 tool name"
string
default "mr17s_cfg"

config BR2_SIGRAND_OEM_MR17S_TTYNAME
prompt "MR17S RS232 tty name"
string
default "ttyRS"
```

## package/oem-voip/Config.in
```kconfig
config BR2_PACKAGE_OEM_VOIP
	tristate "oem-voip........... SIP VoIP drivers and routines"
	default y if CONFIG_DEVEL
	depends on BR2_LINUX_2_6_SIGRAND5120
```

## package/spcaview/Config.in
```kconfig
config BR2_PACKAGE_SPCAVIEW
	prompt "spcaview.......................... This set of tools are provide to test WebCam under Linux"
	tristate
	default m if CONFIG_DEVEL
	help
	  This set of tools are provide to test WebCam under Linux.
	  
	  http://mxhaard.free.fr/
	  
```

## package/wf2/Config.in
```kconfig
config BR2_PACKAGE_WF2
	prompt "webface2....................... Sigrand Webface 2"
	tristate
	default n
	select BR2_PACKAGE_WEBFACE
	help
	  New web interface which uses AJAX. All HTML components rendered by JavaScript.
	  
```

## package/wget/Config.in
```kconfig
config BR2_PACKAGE_WGET
	prompt "wget.............................. Non-interactive network downloader"
	tristate
	default n
	help
		Wget is a network utility to retrieve files from the Web using http 
		and ftp, the two most widely used Internet protocols. It works 
		non-interactively, so it will work in the background, after having 
		logged off. The program supports recursive retrieval of web-authoring 
		pages as well as ftp sites -- you can use wget to make mirrors of 
		archives and home pages or to travel the Web like a WWW robot.
     
		http://www.gnu.org/software/wget/index.html
```

## target/linux/package/mmc/Config.in
```kconfig
config BR2_PACKAGE_KMOD_MMC
        prompt "kmod-mmc.......................... SD/MMC support driver"
        tristate
	default n
        help
          Kernel support for SD/MMC card
	  
	  http://kiel.kool.dk/
```
